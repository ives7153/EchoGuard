## firmware/gateway/sdkconfig.defaults
```kconfig
CONFIG_IDF_TARGET="esp32s3"
CONFIG_ESPTOOLPY_FLASHSIZE_8MB=y
CONFIG_ESPTOOLPY_FLASHSIZE="8MB"

# ESP32-S3 Gateway 通过板载 USB Serial/JTAG 向上位机输出 JSON Lines。
# 115200 保留为串口工具兼容波特率；USB Serial/JTAG 本身不依赖外置 UART 桥。
# CONFIG_ESP_CONSOLE_UART_DEFAULT is not set
# CONFIG_ESP_CONSOLE_USB_CDC is not set
CONFIG_ESP_CONSOLE_USB_SERIAL_JTAG=y
# CONFIG_ESP_CONSOLE_UART_CUSTOM is not set
# CONFIG_ESP_CONSOLE_NONE is not set
CONFIG_ESP_CONSOLE_USB_SERIAL_JTAG_ENABLED=y
CONFIG_ESP_CONSOLE_UART_BAUDRATE=115200

# Wi-Fi SoftAP 与 FreeRTOS 基础配置。
CONFIG_ESP_WIFI_ENABLED=y
CONFIG_ESP_WIFI_SOFTAP_SUPPORT=y
CONFIG_FREERTOS_HZ=100
CONFIG_FREERTOS_CHECK_STACKOVERFLOW_CANARY=y

CONFIG_PARTITION_TABLE_CUSTOM=y
CONFIG_PARTITION_TABLE_CUSTOM_FILENAME="../../partitions-8Mib.csv"
CONFIG_PARTITION_TABLE_FILENAME="../../partitions-8Mib.csv"
```

## firmware/node/main/Kconfig.projbuild
```kconfig
menu "Rescue Node Configuration"

    config RESCUE_NODE_ID
        int "Rescue node ID"
        range 1 255
        default 1
        help
            Unique node ID sent in the LoRa payload and Gateway JSON frame.
            Set a different ID before flashing each physical rescue node.

endmenu
```

## firmware/node/sdkconfig.defaults
```kconfig
CONFIG_IDF_TARGET="esp32s3"
CONFIG_ESPTOOLPY_FLASHSIZE_8MB=y
CONFIG_ESPTOOLPY_FLASHSIZE="8MB"

# ESP32-S3 Node console over onboard USB Serial/JTAG.
# Keep 115200 for monitor-tool compatibility.
# CONFIG_ESP_CONSOLE_UART_DEFAULT is not set
# CONFIG_ESP_CONSOLE_USB_CDC is not set
CONFIG_ESP_CONSOLE_USB_SERIAL_JTAG=y
# CONFIG_ESP_CONSOLE_UART_CUSTOM is not set
# CONFIG_ESP_CONSOLE_NONE is not set
CONFIG_ESP_CONSOLE_USB_SERIAL_JTAG_ENABLED=y
CONFIG_ESP_CONSOLE_UART_BAUDRATE=115200

# WiFi STA + CSI capture. ESP-IDF 5.x uses CONFIG_ESP_WIFI_CSI_ENABLED;
# keep the ESP32 compatibility symbol for old sdkconfig migration.
CONFIG_ESP_WIFI_ENABLED=y
CONFIG_ESP_WIFI_STA_DISCONNECTED_PM_ENABLE=n
CONFIG_ESP_WIFI_CSI_ENABLED=y
CONFIG_ESP32_WIFI_CSI_ENABLED=y

# FreeRTOS stability settings for long-running field nodes.
CONFIG_FREERTOS_HZ=100
CONFIG_FREERTOS_CHECK_STACKOVERFLOW_CANARY=y

CONFIG_PARTITION_TABLE_CUSTOM=y
CONFIG_PARTITION_TABLE_CUSTOM_FILENAME="../../partitions-8Mib.csv"
CONFIG_PARTITION_TABLE_FILENAME="../../partitions-8Mib.csv"
```
